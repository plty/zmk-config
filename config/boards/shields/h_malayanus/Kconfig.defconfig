## config/boards/shields/h_malayanus/Kconfig.defconfig
```kconfig
if SHIELD_H_MALAYANUS
config ZMK_KEYBOARD_NAME
    default "Helarctos malayanus"
config ZMK_USB
	default y
endif
```

## config/boards/shields/ice_bear/Kconfig.defconfig
```kconfig
if SHIELD_ICE_BEAR_LEFT

config ZMK_KEYBOARD_NAME
    default "ice bear"

config ZMK_SPLIT_BLE_ROLE_CENTRAL
    default y

endif

if SHIELD_ICE_BEAR_LEFT || SHIELD_ICE_BEAR_RIGHT

config ZMK_SPLIT
    default y
```

## config/boards/shields/ice_bear/Kconfig.shield
```kconfig
config SHIELD_ICE_BEAR_LEFT
    def_bool $(shields_list_contains,ice_bear_left)

config SHIELD_ICE_BEAR_RIGHT
    def_bool $(shields_list_contains,ice_bear_right)
```
